## CMakeLists.txt
```
# SPDX-License-Identifier: Apache-2.0

cmake_minimum_required(VERSION 3.20.0)

find_package(Zephyr REQUIRED HINTS $ENV{ZEPHYR_BASE})
project(sm)

target_sources(app PRIVATE src/main.c)
```

## Kconfig
```
# Copyright (c) 2024 Golioth, Inc.
# SPDX-License-Identifier: Apache-2.0

source "${ZEPHYR_GOLIOTH_FIRMWARE_SDK_MODULE_DIR}/examples/zephyr/common/Kconfig.defconfig"

source "Kconfig.zephyr"
```

## west.yml
```
# Copyright (c) 2022-2024 Golioth, Inc.
# SPDX-License-Identifier: Apache-2.0

manifest:
  version: 0.8

  projects:
    - name: zephyr
      revision: v3.6.0
      url: https://github.com/zephyrproject-rtos/zephyr.git
      import:
        path-prefix: deps
        name-allowlist:
          - zephyr
          - cmsis
          - hal_espressif
          - mbedtls
          - mcuboot
          - net-tools
          - segger
          - tfm-mcuboot
          - tinycrypt
          - trusted-firmware-m
          - zcbor
    - name: golioth
      path: modules/lib/golioth-firmware-sdk
      revision: v0.14.0
      url: https://github.com/golioth/golioth-firmware-sdk.git
      submodules: true

  self:
    path: fw
```

## prj.conf
```kconfig
# Application
CONFIG_GOLIOTH_SAMPLE_COMMON=y
CONFIG_GOLIOTH_SAMPLE_HARDCODED_CREDENTIALS=y
CONFIG_LOG_BACKEND_GOLIOTH=y

# Golioth Firmware SDK with all dependencies
CONFIG_GOLIOTH_FIRMWARE_SDK=y

# Credentials
CONFIG_GOLIOTH_SAMPLE_PSK_ID="<psk-id>"
CONFIG_GOLIOTH_SAMPLE_PSK="<psk>"
CONFIG_GOLIOTH_SAMPLE_WIFI_SSID="<ssid>"
CONFIG_GOLIOTH_SAMPLE_WIFI_PSK="<psk>"
```

## src/main.c
```c
/*
 * Copyright (c) 2024 Golioth, Inc.
 *
 * SPDX-License-Identifier: Apache-2.0
 */

#include <zephyr/logging/log.h>
LOG_MODULE_REGISTER(hello_zephyr, LOG_LEVEL_DBG);

#include <golioth/client.h>
#include <samples/common/sample_credentials.h>
#include <string.h>
#include <zephyr/kernel.h>

#include <samples/common/net_connect.h>

struct golioth_client *client;
static K_SEM_DEFINE(connected, 0, 1);

static void on_client_event(struct golioth_client *client,
                            enum golioth_client_event event, void *arg) {
  bool is_connected = (event == GOLIOTH_CLIENT_EVENT_CONNECTED);
  if (is_connected) {
    k_sem_give(&connected);
  }
  LOG_INF("Golioth client %s", is_connected ? "connected" : "disconnected");
}

int main(void) {
  int counter = 0;

  LOG_DBG("start hello sample");

  net_connect();

  /* Note: In production, you would provision unique credentials onto each
   * device. For simplicity, we provide a utility to hardcode credentials as
   * kconfig options in the samples.
   */
  const struct golioth_client_config *client_config =
      golioth_sample_credentials_get();

  client = golioth_client_create(client_config);

  golioth_client_register_event_callback(client, on_client_event, NULL);

  k_sem_take(&connected, K_FOREVER);

  while (true) {
    LOG_INF("Sending hello! %d", counter);

    ++counter;
    k_sleep(K_SECONDS(5));
  }

  return 0;
}
```
